## config/west.yml
```yaml
manifest:
  remotes:
    - name: zmkfirmware
      url-base: https://github.com/bdgerszewski
  projects:
    - name: zmk
      remote: zmkfirmware
      revision: merge
      import: app/west.yml
  self:
    path: config
```
